## firmware/main/Kconfig.projbuild
```kconfig
menu "Stillframe development tests"
config SF_PANEL_MAINTENANCE
    bool "Disable all e-paper power and refresh operations"
    default n
    help
        Keeps GPIO45 and panel reset low and skips SPI initialization. Use for
        provisioning, network and OTA diagnosis with the panel disconnected.
config SF_OPEN_AP_DIAGNOSTIC
    bool "Run an open setup AP for authentication diagnosis"
    default n
    help
        Removes WPA authentication from the setup AP. Never enable in a
        release build; this exists only to isolate client authentication faults.
config SF_TEST_MODE
    bool "Run protocol, NVS and OTA tests instead of the photo loop"
    default n
config SF_TEST_PANIC
    bool "Build deliberate startup panic fixture (never install on hardware)"
    default n
config SF_RUNTIME_TEST
    bool "Exercise real driver timeout, HTTP and worker liveness for 90 seconds"
    default n
endmenu
```

## firmware/sdkconfig.defaults
```kconfig
CONFIG_IDF_TARGET="esp32s3"
CONFIG_ESPTOOLPY_FLASHSIZE_16MB=y
CONFIG_PARTITION_TABLE_CUSTOM=y
CONFIG_PARTITION_TABLE_CUSTOM_FILENAME="partitions.csv"
CONFIG_BOOTLOADER_APP_ROLLBACK_ENABLE=y
CONFIG_SPIRAM=y
CONFIG_SPIRAM_MODE_OCT=y
CONFIG_SPIRAM_SPEED_80M=y
CONFIG_SPIRAM_IGNORE_NOTFOUND=y
CONFIG_SPIRAM_USE_MALLOC=y
CONFIG_ESP_MAIN_TASK_STACK_SIZE=12288
CONFIG_ESP_TASK_WDT_EN=y
CONFIG_ESP_TASK_WDT_INIT=y
CONFIG_ESP_TASK_WDT_PANIC=y
CONFIG_ESP_TASK_WDT_TIMEOUT_S=30
CONFIG_HTTPD_MAX_REQ_HDR_LEN=1024
CONFIG_HTTPD_MAX_URI_LEN=512
CONFIG_MBEDTLS_CERTIFICATE_BUNDLE=y
CONFIG_COMPILER_OPTIMIZATION_SIZE=y
CONFIG_FATFS_LFN_HEAP=y

CONFIG_ESP_HTTP_CLIENT_ENABLE_CUSTOM_TRANSPORT=y

# Automatic light sleep between refreshes (Wi-Fi stays associated)
CONFIG_PM_ENABLE=y
CONFIG_FREERTOS_USE_TICKLESS_IDLE=y
# Keep USB serial logs usable while a computer is attached
CONFIG_USJ_NO_AUTO_LS_ON_CONNECTION=y
```
